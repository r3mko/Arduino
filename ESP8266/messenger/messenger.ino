// Version 1.1
// Author: Remko Kleinjan
// Date: 280123

#include <ESP8266WiFi.h>
#include <ESP8266HTTPClient.h>
#include <WiFiClient.h>
#include <Adafruit_SSD1306.h>
#include <ArduinoJson.h>

// OLED
#define OLED_RESET 0
#define SCREEN_ADDRESS 0x3C
Adafruit_SSD1306 display(OLED_RESET);

// Button
#define BUTTON D3

// WiFi
const char* ssid = "<SSID>";
const char* password = "<PASS>";

int waitDelay = 1000;

// HTTP
const char* url = "http://<IP>:2512";
int retryDelay = 5000;
int retryCount = 0;
int retry = 2;

// Messages
const char* from = "<USER1>";
const char* to = "<USER2>";
bool messages = false;
int check = 400;

// Button
int buttonDelay = 100;
bool next = false;

// Display
int standby = 0;
int sleep_after = 5; // minutes

// Images
// 'mail', 64x48px
const unsigned char mail [] PROGMEM = {
	0x00, 0x00, 0x00, 0x00, 0x00, 0x00, 0x00, 0x00, 0x00, 0x00, 0x00, 0x00, 0x00, 0x00, 0x00, 0x00, 
	0x00, 0x00, 0x00, 0x00, 0x00, 0x00, 0x00, 0x00, 0x00, 0x00, 0x00, 0x00, 0x00, 0x00, 0x00, 0x00, 
	0x00, 0x00, 0x00, 0x00, 0x00, 0x00, 0x00, 0x00, 0x00, 0x00, 0x00, 0x00, 0x00, 0x00, 0x00, 0x00, 
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	0x00, 0x00, 0x00, 0x00, 0x00, 0x00, 0x00, 0x00, 0x00, 0x00, 0x00, 0x00, 0x00, 0x00, 0x00, 0x00
};
// 'mail_send', 64x48px
const unsigned char mail_send [] PROGMEM = {
	0x00, 0x00, 0x00, 0x00, 0x00, 0x00, 0x00, 0x00, 0x00, 0x00, 0x00, 0x00, 0x00, 0x00, 0x00, 0x00, 
	0x00, 0x00, 0x00, 0x00, 0x00, 0x00, 0x00, 0x00, 0x00, 0x00, 0x00, 0x00, 0x00, 0x00, 0x00, 0x00, 
	0x00, 0x00, 0x00, 0x00, 0x00, 0x00, 0x00, 0x00, 0x00, 0x00, 0x00, 0x00, 0x00, 0x00, 0x00, 0x00, 
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	0x00, 0x00, 0x00, 0x00, 0x00, 0x00, 0x00, 0x00, 0x00, 0x00, 0x00, 0x00, 0x00, 0x00, 0x00, 0x00
};
// 'mail_ok', 64x48px
const unsigned char mail_ok [] PROGMEM = {
	0x00, 0x00, 0x00, 0x00, 0x00, 0x00, 0x00, 0x00, 0x00, 0x00, 0x00, 0x00, 0x00, 0x00, 0x00, 0x00, 
	0x00, 0x00, 0x00, 0x00, 0x00, 0x00, 0x00, 0x00, 0x00, 0x00, 0x00, 0x00, 0x00, 0x00, 0x00, 0x00, 
	0x00, 0x00, 0x00, 0x00, 0x00, 0x00, 0x00, 0x00, 0x00, 0x00, 0x00, 0x00, 0x00, 0x00, 0x00, 0x00, 
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	0x00, 0x00, 0x00, 0x00, 0x00, 0x00, 0x00, 0x00, 0x00, 0x00, 0x00, 0x00, 0x00, 0x00, 0x00, 0x00
};
// 'new_mail', 64x48px
const unsigned char new_mail [] PROGMEM = {
	0x00, 0x00, 0x00, 0x00, 0x00, 0x00, 0x00, 0x00, 0x00, 0x00, 0x00, 0x00, 0x00, 0x00, 0x00, 0x00, 
	0x00, 0x00, 0x00, 0x00, 0x00, 0x00, 0x00, 0x00, 0x00, 0x00, 0x00, 0x00, 0x00, 0x00, 0x00, 0x00, 
	0x00, 0x00, 0x00, 0x00, 0x00, 0x00, 0x00, 0x00, 0x00, 0x00, 0x00, 0x00, 0x00, 0x1f, 0x80, 0x00, 
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	0x00, 0x00, 0x00, 0x00, 0x00, 0x00, 0x00, 0x00, 0x00, 0x00, 0x00, 0x00, 0x00, 0x00, 0x00, 0x00
};
// 'heart', 64x48px
const unsigned char heart [] PROGMEM = {
	0x00, 0x00, 0x00, 0x00, 0x00, 0x00, 0x00, 0x00, 0x00, 0x00, 0x00, 0x00, 0x00, 0x00, 0x00, 0x00, 
	0x00, 0x00, 0x00, 0x00, 0x00, 0x00, 0x00, 0x00, 0x00, 0x00, 0x00, 0x00, 0x00, 0x00, 0x00, 0x00, 
	0x00, 0x00, 0x00, 0x00, 0x00, 0x00, 0x00, 0x00, 0x00, 0x00, 0x0f, 0x80, 0x01, 0xe0, 0x00, 0x00, 
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	0x00, 0x00, 0x00, 0x00, 0x00, 0x00, 0x00, 0x00, 0x00, 0x00, 0x00, 0x00, 0x00, 0x00, 0x00, 0x00
};

void setupDisplay() {
  display.begin(SSD1306_SWITCHCAPVCC, SCREEN_ADDRESS);
  display.clearDisplay();
  display.drawBitmap(0, 0, heart, 64, 48, WHITE);
  display.display();
}

void setupWifi() {
  WiFi.mode(WIFI_STA);
  WiFi.begin(ssid, password);

  Serial.print("Connecting");
  while (WiFi.status() != WL_CONNECTED) {
    delay(waitDelay);
    Serial.print(".");
  }
  Serial.println();

  Serial.print("Connected to: ");
  Serial.println(WiFi.SSID());
  Serial.print("IP: ");
  Serial.println(WiFi.localIP());
  Serial.println();

  WiFi.setAutoReconnect(true);
  //WiFi.persistent(true);
}

void setup() {
  setupDisplay();

  Serial.begin(9600);
  Serial.println();
  Serial.println("Starting:");
  Serial.println("Messenger v1.1");
  Serial.println();

  pinMode(BUILTIN_LED, OUTPUT);
  pinMode(BUTTON, INPUT);

  setupWifi();
}

String request(String get) {
  if (WiFi.status() == WL_CONNECTED) {
    HTTPClient http;
    WiFiClient wifiClient;
   
    Serial.println("Request: " + get);

    http.begin(wifiClient, url + get);
    http.setTimeout(retryDelay);

    int httpResponseCode = http.GET();
    
    if (httpResponseCode > 0) {
      Serial.print("HTTP Response code: ");
      Serial.println(httpResponseCode);
      String payload = http.getString();
      Serial.print("HTTP Response: ");
      Serial.println(payload);
      wifiClient.stop();
      http.end();
      return payload;
    } else {
      Serial.print("Error code: ");
      Serial.println(httpResponseCode);
      wifiClient.stop();
      http.end();

      delay(retryDelay);
      if (retryCount < retry) {
        retryCount++;
        request(get);
      } else {
        retryCount = 0;
      }
      return "";
    }
  } else {
    Serial.println("WiFi not connected ¯\\_(ツ)_/¯");
    return "";
  }
}

void drawImage(const uint8_t * image) {
  display.clearDisplay();
  display.drawBitmap(0, 0, image, 64, 48, WHITE);
  display.display();
}

void drawText(const char* text) {
  display.clearDisplay();
  display.setTextSize(1);
  display.setTextColor(WHITE);
  display.setCursor(0,0);
  display.println(text);
  display.display();
}

int parseJSON(String json) {
  StaticJsonDocument<128> root;
  DeserializationError error = deserializeJson(root, json);

  if (error) {
    Serial.print("Parsing JSON failed: ");
    Serial.println(error.f_str());
    return 0;
  }

  if (root["result"]) {
    if (root["result"]["messages"]) {
      return root["result"]["messages"];
    } else if (root["result"]["send"]) {
      return 1;
    } else if (root["result"]["read"]) {
      return 1;
    } else {
      return 0;
    }
  } else if (root["error"]) {
    //const char* error = root["error"]["message"];
    //Serial.println(error);
    return 0;
  } else {
    return 0;
  }
}

void getMessages() {
  String result = request(String("/v1/get/") + from);
  int status = parseJSON(result);

  if (status > 0) {
    drawImage(new_mail);
    messages = true;
    standby = 0;

    delay(buttonDelay);
    while (digitalRead(BUTTON) == HIGH) {
      delay(buttonDelay);
    }
    Serial.println("Button!");
  } else {
    messages = false;
  }
};

void readMessages() {
  int message_pool_size = 3;
  const char* message_pool[message_pool_size] = {"Message 1",
                                                  "Message 2",
                                                  "Message 3"
                                                  };
  drawText(message_pool[random(message_pool_size)]);

  request(String("/v1/read/") + from);

  delay(buttonDelay);
  while (digitalRead(BUTTON) == HIGH) {
    delay(buttonDelay);
  }
  Serial.println("Button!");
  getMessages();
};

void sendMessage() {
  drawImage(mail_send);
  String result = request(String("/v1/send/") + to);
  int status = parseJSON(result);
  delay(1000);

  if (status > 0) {
    drawImage(mail_ok);
    delay(1000);
  }
};

void loop() {
  if (standby > sleep_after) {
    // Put display to sleep after X minutes
    display.clearDisplay();
    display.display();
  } else {
    drawImage(mail);
  }

  delay(buttonDelay);

  if (digitalRead(BUTTON) == LOW) {
    if (standby > sleep_after) {
      // Wake up display
    } else {
      next = true;
    }
    standby = 0;
    Serial.println("Button!");
  } else {
    next = false;
  }

  if (check == 400) {
    check = 0;
    standby++;
    //Serial.println("[tick]");
    getMessages();
  }
  check++;

  if (messages) {
    readMessages();
  } else if (next) {
    sendMessage();   
  }
}
